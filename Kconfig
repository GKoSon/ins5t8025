## Kconfig
```kconfig
config PKG_USING_INS5T8025
    bool "Enable INS5T8025 package"
    default n
    help
        Enable INS5T8025 package.


if PKG_USING_INS5T8025

	config INS5T8025_I2C_BUS
	    string "name of IIC bus for INS5T8025"
	    default "i2c2_sw"
	    help
	        Set INS5T8025 I2C bus.  

	config INS5T8025_ALARM_INT_PIN
	    string "INS5T8025 ALARM INT Pin"
	    default "PE.4"
	    help
	        Configure the GPIO pin (format: Port.Pin, e.g., PB.12).
  
    config USING_INS5T8025_DEMO
        bool "Enable INS5T8025 Demo (example folder)"
        default n
        help
            Enable this option to compile the example code in the "example" folder.
endif 
```
